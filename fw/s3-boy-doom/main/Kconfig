## fw/s3-boy-doom/main/Kconfig
```kconfig
menu "EMULATOR"

    choice EMUL_PLATFORM
        bool "Emulator"
        help
            Select the Emulator.

        config EMUL_PLATFORM_DOOM
            bool "DOOM"
            help
                DOOM Emulator.

        config EMUL_PLATFORM_GNUBOY
            bool "GNUBOY"
            help
                GNUBOY Emultor.

        config EMUL_PLATFORM_NONE
            bool "NONE"
            help
                Emultor Not Use.                

    endchoice
endmenu
```

## sdkconfig.defaults
```kconfig
CONFIG_IDF_TARGET="esp32s3"

CONFIG_ESPTOOLPY_FLASHMODE_QIO=y
CONFIG_ESPTOOLPY_FLASHSIZE_16MB=y
CONFIG_ESPTOOLPY_HEADER_FLASHSIZE_UPDATE=y
CONFIG_SPIRAM=y
CONFIG_SPIRAM_MODE_OCT=y
CONFIG_SPIRAM_SPEED_80M=y
CONFIG_SPIRAM_USE_CAPS_ALLOC=y

CONFIG_ESP_DEFAULT_CPU_FREQ_MHZ_240=y
CONFIG_FREERTOS_HZ=1000
CONFIG_TINYUSB=y
CONFIG_TINYUSB_CDC_ENABLED=y
CONFIG_SPI_FLASH_SIZE_OVERRIDE=n

CONFIG_ESP_CONSOLE_USB_SERIAL_JTAG=n

CONFIG_ESP32S3_INSTRUCTION_CACHE_32KB=y
CONFIG_ESP32S3_DATA_CACHE_64KB=y
CONFIG_ESP32S3_DATA_CACHE_LINE_64B=y

CONFIG_SPIRAM_FETCH_INSTRUCTIONS=n
CONFIG_SPIRAM_RODATA=y

CONFIG_FATFS_CODEPAGE_949=y
CONFIG_FATFS_LFN_STACK=y
CONFIG_FATFS_API_ENCODING_UTF_8=y

CONFIG_PARTITION_TABLE_CUSTOM=y
CONFIG_SPIRAM_ALLOW_BSS_SEG_EXTERNAL_MEMORY=y
CONFIG_SPIRAM_USE_MALLOC=y

CONFIG_EMUL_PLATFORM_DOOM=n
CONFIG_EMUL_PLATFORM_NONE=y
```
